## rpi/meta-seinot/conf/distro/poky-seinot.conf
```bitbake
require conf/distro/poky.conf

DISTRO = "poky-seinot"
DISTROOVERRIDES = "poky:poky-seinot"

INIT_MANAGER = "systemd"
VIRTUAL-RUNTIME_syslog = ""
VIRTUAL-RUNTIME_base-utils-syslog = ""

DISTRO_FEATURES = "\
    alsa \
    argp \
    ipv4 \
    ipv6 \
    sysvinit \
    usbgadget \
    usbhost \
    wifi \
    "
DISTRO_FEATURES_BACKFILL_CONSIDERED = "\
    gobject-introspection-data \
    ldconfig \
    pulseaudio \
    "

PACKAGE_CLASSES = "package_rpm"
```

## rpi/meta-seinot/conf/machine/seinot-rpi0w.conf
```bitbake
require conf/machine/raspberrypi0-wifi.conf

WKS_FILE = "sdimage-seinot.wks"

#    kernel-module-brcmfmac
#    kernel-module-brcmutil
#    kernel-module-cfg80211
#    kernel-module-raspberrypi-hwmon
#    kernel-module-rfkill
#    kernel-module-rotary-encoder
#    kernel-module-sha256-generic
MACHINE_EXTRA_RRECOMMENDS = "\
    kernel-modules \
    linux-firmware-rpidistro-bcm43430 \
    wireless-regdb \
    "
MACHINE_FEATURES:remove = "\
    bluetooth \
    keyboard \
    screen \
    touchscreen \
    "
MACHINE_FEATURES_BACKFILL_CONSIDERED = "\
    rtc \
    qemu-usermode \
    "

DISABLE_VC4GRAPHICS = "1"
DISABLE_SPLASH = "1"
# FIXME
ENABLE_UART = "1"

RPI_EXTRA_CONFIG = "\
dtoverlay=rpi-digiampplus\n\
dtoverlay=rotary-encoder\n\
dtoverlay=seinot"
```

## rpi/meta-seinot/conf/machine/seinot-rpi3.conf
```bitbake
require conf/machine/raspberrypi3-64.conf
SDIMG_KERNELIMAGE = "kernel8.img"

RPI_KERNEL_DEVICETREE_OVERLAYS = "\
    overlays/overlay_map.dtb \
    overlays/rpi-digiampplus.dtbo \
    overlays/rotary-encoder.dtbo \
    overlays/seinot.dtbo \
    "

WKS_FILE = "sdimage-seinot.wks"

MACHINE_EXTRA_RRECOMMENDS:remove = "udev-rules-rpi"

MACHINE_FEATURES = "\
    apm \
    usbhost \
    vfat \
    ext2 \
    alsa \
    bluetooth \
    wifi \
    sdio \
    "
MACHINE_FEATURES_BACKFILL_CONSIDERED = "\
    rtc \
    qemu-usermode \
    "

DISABLE_VC4GRAPHICS = "1"
DISABLE_SPLASH = "1"

# Enable UART but disable console since we'll use that for NFC comms
ENABLE_UART = "1"
SERIAL_CONSOLES = ""

RPI_EXTRA_CONFIG = "\
dtoverlay=rpi-digiampplus\n\
dtoverlay=rotary-encoder,relative_axis\n\
dtoverlay=seinot"
```
